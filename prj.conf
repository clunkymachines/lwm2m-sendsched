## CMakeLists.txt
```
cmake_minimum_required(VERSION 3.20.0)

find_package(Zephyr REQUIRED HINTS $ENV{ZEPHYR_BASE})
project(lwm2m_base_client)

target_sources(app PRIVATE
  src/main.c
  src/temperature_sensor.c
  src/humidity_sensor.c
)
```

## Kconfig
```
mainmenu "LwM2M Base Client"

config NET_SAMPLE_LWM2M_ID
	string "LwM2M client endpoint"
	default ""
	help
	  Endpoint name used when registering to the server. Leave empty to use
	  CONFIG_BOARD.

config NET_SAMPLE_LWM2M_SERVER
	string "LwM2M server URI"
	default "coap://leshan.eclipseprojects.io:5683"
	help
	  Complete URI of the LwM2M server, for example "coap://1.2.3.4:5683".

config SEND_SCHED_LOG_LEVEL
	int "Send scheduler log level"
	range 0 4
	default 1
	help
	  Controls the Zephyr logging level for the custom send scheduler:
	  0=none, 1=error, 2=warn, 3=info, 4=debug.

source "Kconfig.zephyr"
```

## prj.conf
```kconfig
CONFIG_NETWORKING=y
CONFIG_LOG=y
CONFIG_GPIO=y
CONFIG_TEST_RANDOM_GENERATOR=y

CONFIG_NET_IPV6=y
CONFIG_NET_IPV4=y
CONFIG_NET_CONNECTION_MANAGER=y
CONFIG_NET_LOG=y

CONFIG_NET_CONFIG_SETTINGS=y
CONFIG_NET_CONFIG_NEED_IPV6=y
CONFIG_NET_CONFIG_NEED_IPV4=y
CONFIG_NET_CONFIG_MY_IPV6_ADDR="2001:db8::1"
CONFIG_NET_CONFIG_PEER_IPV6_ADDR="2001:db8::2"
CONFIG_NET_CONFIG_MY_IPV4_ADDR="192.0.2.1"
CONFIG_NET_CONFIG_PEER_IPV4_ADDR="192.0.2.2"
CONFIG_NET_CONFIG_MY_IPV4_GW="192.0.2.2"

CONFIG_LWM2M=y
CONFIG_NET_SAMPLE_LWM2M_SERVER="coap://192.0.2.2:5683"
CONFIG_LWM2M_DTLS_SUPPORT=n
CONFIG_LWM2M_VERSION_1_1=y
CONFIG_LWM2M_LOG_LEVEL_DBG=y
CONFIG_LWM2M_QUEUE_MODE_ENABLED=y
CONFIG_LWM2M_IPSO_SUPPORT=y
CONFIG_LWM2M_IPSO_TEMP_SENSOR=y
CONFIG_LWM2M_IPSO_HUMIDITY_SENSOR=y
CONFIG_LWM2M_RESOURCE_DATA_CACHE_SUPPORT=y
CONFIG_LWM2M_SEND_SCHEDULER=y

# Longer endpoint name might be returned in a registration reply
CONFIG_COAP_EXTENDED_OPTIONS_LEN=y
CONFIG_COAP_EXTENDED_OPTIONS_LEN_VALUE=40

# cbor and senml
CONFIG_LWM2M_RW_SENML_CBOR_SUPPORT=y
#CONFIG_LWM2M_RW_SENML_CBOR_RECORDS=30
CONFIG_ZCBOR=y
CONFIG_ZCBOR_CANONICAL=y
CONFIG_CBPRINTF_FP_SUPPORT=y
CONFIG_LWM2M_SEND_SCHEDULER_LOG_LEVEL_DBG=y
```

## src/main.c
```c
#include <errno.h>
#include <zephyr/kernel.h>
#include <zephyr/logging/log.h>
#include <zephyr/net/lwm2m.h>
#include <zephyr/net/net_if.h>
#include <zephyr/net/net_mgmt.h>
#include <zephyr/net/conn_mgr_monitor.h>
#include <zephyr/net/conn_mgr_connectivity.h>
#include <zephyr/net/lwm2m_send_scheduler.h>

#include <string.h>

#include "temperature_sensor.h"
#include "humidity_sensor.h"
LOG_MODULE_REGISTER(lwm2m_base_client, LOG_LEVEL_INF);

#define APP_BANNER "LwM2M base client"

static struct lwm2m_ctx client_ctx;

static const char *const endpoint =
	sizeof(CONFIG_NET_SAMPLE_LWM2M_ID) > 1 ? CONFIG_NET_SAMPLE_LWM2M_ID :
						 CONFIG_BOARD;

#if defined(CONFIG_NET_CONNECTION_MANAGER)
static K_SEM_DEFINE(network_connected_sem, 0, 1);
static struct net_mgmt_event_callback l4_cb;
#endif

static K_SEM_DEFINE(quit_lock, 0, K_SEM_MAX_LIMIT);

static uint8_t bat_idx = LWM2M_DEVICE_PWR_SRC_TYPE_BAT_INT;
static int bat_mv = 3800;
static int bat_ma = 125;
static uint8_t usb_idx = LWM2M_DEVICE_PWR_SRC_TYPE_USB;
static int usb_mv = 5000;
static int usb_ma = 900;
static uint8_t bat_level = 95;
static uint8_t bat_status = LWM2M_DEVICE_BATTERY_STATUS_CHARGING;
static int mem_free = 15;
static int mem_total = 25;

static int device_reboot_cb(uint16_t obj_inst_id, uint8_t *args,
			    uint16_t args_len)
{
	ARG_UNUSED(obj_inst_id);
	ARG_UNUSED(args);
	ARG_UNUSED(args_len);

	LOG_INF("DEVICE: REBOOT");

	return 0;
}

static int lwm2m_setup(void)
{
	static char manufacturer[] = "Zephyr";
	static char model_number[] = "Base LwM2M Client";
	static char serial_number[] = "0001";
	static char firmware_version[] = "1.0";
	static char hardware_version[] = "1.0";

	int ret;

	ret = lwm2m_set_string(&LWM2M_OBJ(0, 0, 0), CONFIG_NET_SAMPLE_LWM2M_SERVER);
	if (ret < 0) {
		return ret;
	}

	lwm2m_set_u8(&LWM2M_OBJ(0, 0, 2), 3);
	lwm2m_set_u16(&LWM2M_OBJ(0, 0, 10), CONFIG_LWM2M_SERVER_DEFAULT_SSID);
	lwm2m_set_u16(&LWM2M_OBJ(1, 0, 0), CONFIG_LWM2M_SERVER_DEFAULT_SSID);

	lwm2m_set_res_buf(&LWM2M_OBJ(3, 0, 0), manufacturer, sizeof(manufacturer),
			  sizeof(manufacturer), LWM2M_RES_DATA_FLAG_RO);
	lwm2m_set_res_buf(&LWM2M_OBJ(3, 0, 1), model_number, sizeof(model_number),
			  sizeof(model_number), LWM2M_RES_DATA_FLAG_RO);
	lwm2m_set_res_buf(&LWM2M_OBJ(3, 0, 2), serial_number,
			  sizeof(serial_number),
			  sizeof(serial_number), LWM2M_RES_DATA_FLAG_RO);
	lwm2m_set_res_buf(&LWM2M_OBJ(3, 0, 3), firmware_version,
			  sizeof(firmware_version),
			  sizeof(firmware_version), LWM2M_RES_DATA_FLAG_RO);
	lwm2m_set_res_buf(&LWM2M_OBJ(3, 0, 17), CONFIG_BOARD, sizeof(CONFIG_BOARD),
			  sizeof(CONFIG_BOARD), LWM2M_RES_DATA_FLAG_RO);
	lwm2m_set_res_buf(&LWM2M_OBJ(3, 0, 18), hardware_version,
			  sizeof(hardware_version),
			  sizeof(hardware_version), LWM2M_RES_DATA_FLAG_RO);

	lwm2m_register_exec_callback(&LWM2M_OBJ(3, 0, 4), device_reboot_cb);

	lwm2m_set_res_buf(&LWM2M_OBJ(3, 0, 9), &bat_level, sizeof(bat_level),
			  sizeof(bat_level), 0);
	lwm2m_set_res_buf(&LWM2M_OBJ(3, 0, 10), &mem_free, sizeof(mem_free),
			  sizeof(mem_free), 0);
	lwm2m_set_res_buf(&LWM2M_OBJ(3, 0, 20), &bat_status, sizeof(bat_status),
			  sizeof(bat_status), 0);
	lwm2m_set_res_buf(&LWM2M_OBJ(3, 0, 21), &mem_total, sizeof(mem_total),
			  sizeof(mem_total), 0);

	lwm2m_create_res_inst(&LWM2M_OBJ(3, 0, 6, 0));
	lwm2m_set_res_buf(&LWM2M_OBJ(3, 0, 6, 0), &bat_idx, sizeof(bat_idx),
			  sizeof(bat_idx), 0);
	lwm2m_create_res_inst(&LWM2M_OBJ(3, 0, 7, 0));
	lwm2m_set_res_buf(&LWM2M_OBJ(3, 0, 7, 0), &bat_mv, sizeof(bat_mv),
			  sizeof(bat_mv), 0);
	lwm2m_create_res_inst(&LWM2M_OBJ(3, 0, 8, 0));
	lwm2m_set_res_buf(&LWM2M_OBJ(3, 0, 8, 0), &bat_ma, sizeof(bat_ma),
			  sizeof(bat_ma), 0);

	lwm2m_create_res_inst(&LWM2M_OBJ(3, 0, 6, 1));
	lwm2m_set_res_buf(&LWM2M_OBJ(3, 0, 6, 1), &usb_idx, sizeof(usb_idx),
			  sizeof(usb_idx), 0);
	lwm2m_create_res_inst(&LWM2M_OBJ(3, 0, 7, 1));
	lwm2m_set_res_buf(&LWM2M_OBJ(3, 0, 7, 1), &usb_mv, sizeof(usb_mv),
			  sizeof(usb_mv), 0);
	lwm2m_create_res_inst(&LWM2M_OBJ(3, 0, 8, 1));
	lwm2m_set_res_buf(&LWM2M_OBJ(3, 0, 8, 1), &usb_ma, sizeof(usb_ma),
			  sizeof(usb_ma), 0);

	ret = lwm2m_send_sched_init();
	if (ret < 0) {
		return ret;
	}

	ret = temperature_sensor_init();
	if (ret < 0) {
		return ret;
	}

	ret = humidity_sensor_init();
	if (ret < 0) {
		return ret;
	}

	return 0;
}

static void rd_client_event(struct lwm2m_ctx *ctx,
			    enum lwm2m_rd_client_event event)
{
	ARG_UNUSED(ctx);

	switch (event) {
	case LWM2M_RD_CLIENT_EVENT_REGISTRATION_COMPLETE:
		LOG_INF("Registration complete");
		lwm2m_send_sched_handle_registration_event();
		break;
	case LWM2M_RD_CLIENT_EVENT_REG_UPDATE_COMPLETE:
		LOG_INF("Registration update complete");
		lwm2m_send_sched_handle_registration_event();
		break;
	case LWM2M_RD_CLIENT_EVENT_REG_UPDATE:
		LOG_INF("Registration update in progress");
		break;
	case LWM2M_RD_CLIENT_EVENT_DEREGISTER:
		LOG_INF("Client deregistered");
		break;
	case LWM2M_RD_CLIENT_EVENT_NETWORK_ERROR:
		LOG_ERR("Network error reported by LwM2M engine");
		break;
	default:
		break;
	}
}

#if defined(CONFIG_NET_CONNECTION_MANAGER)
static void on_net_event_l4_connected(void)
{
	LOG_INF("Connected to network");
	k_sem_give(&network_connected_sem);
	lwm2m_engine_resume();
}

static void on_net_event_l4_disconnected(void)
{
	LOG_INF("Disconnected from network");
	lwm2m_engine_pause();
}

static void l4_event_handler(struct net_mgmt_event_callback *cb, uint64_t event,
			     struct net_if *iface)
{
	ARG_UNUSED(cb);
	ARG_UNUSED(iface);

	switch (event) {
	case NET_EVENT_L4_CONNECTED:
		on_net_event_l4_connected();
		break;
	case NET_EVENT_L4_DISCONNECTED:
		on_net_event_l4_disconnected();
		break;
	default:
		break;
	}
}
#endif /* CONFIG_NET_CONNECTION_MANAGER */

int main(void)
{
	int ret;

	LOG_INF(APP_BANNER);

#if defined(CONFIG_NET_CONNECTION_MANAGER)
	struct net_if *iface = net_if_get_default();

	if (!iface) {
		LOG_ERR("No network interface found");
		return -ENODEV;
	}

	net_mgmt_init_event_callback(&l4_cb, l4_event_handler,
				     NET_EVENT_L4_CONNECTED | NET_EVENT_L4_DISCONNECTED);
	net_mgmt_add_event_callback(&l4_cb);

	ret = net_if_up(iface);
	if (ret < 0 && ret != -EALREADY) {
		LOG_ERR("net_if_up failed (%d)", ret);
		return ret;
	}

	(void)conn_mgr_if_connect(iface);

	if (net_if_is_up(iface)) {
		on_net_event_l4_connected();
	}

	LOG_INF("Waiting for network connection...");
	k_sem_take(&network_connected_sem, K_FOREVER);
#endif

	ret = lwm2m_setup();
	if (ret < 0) {
		LOG_ERR("Cannot setup LwM2M resources (%d)", ret);
		return ret;
	}

	memset(&client_ctx, 0, sizeof(client_ctx));
	lwm2m_rd_client_start(&client_ctx, endpoint, 0, rd_client_event, NULL);

	k_sem_take(&quit_lock, K_FOREVER);
	return 0;
}
```

## src/humidity_sensor.c
```c
#define LOG_MODULE_NAME humidity_sensor
#include <zephyr/logging/log.h>
LOG_MODULE_REGISTER(LOG_MODULE_NAME, LOG_LEVEL_INF);

#include <errno.h>
#include <stdint.h>
#include <zephyr/kernel.h>
#include <zephyr/net/lwm2m.h>
#include <zephyr/net/lwm2m_send_scheduler.h>
#include <zephyr/random/random.h>
#include <zephyr/sys/util.h>

#include "humidity_sensor.h"

#define HUMIDITY_OBJECT_ID 3304
#define HUMIDITY_INSTANCE_ID 0
#define HUMIDITY_RES_VALUE 5700
#define HUMIDITY_RES_UNITS 5701

#define HUMIDITY_PERIOD K_SECONDS(3)
#define HUMIDITY_BASE 45.0
#define HUMIDITY_VARIATION 20.0

static struct k_work_delayable humidity_work;
static double humidity_value;
static struct lwm2m_time_series_elem humidity_cache[10];
static const struct lwm2m_obj_path humidity_path =
	LWM2M_OBJ(HUMIDITY_OBJECT_ID, HUMIDITY_INSTANCE_ID, HUMIDITY_RES_VALUE);

static double humidity_sensor_generate(void)
{
	uint32_t rand = sys_rand32_get();
	double scale = (double)rand / (double)UINT32_MAX;

	return HUMIDITY_BASE + (scale * HUMIDITY_VARIATION);
}

static void humidity_work_handler(struct k_work *work)
{
	ARG_UNUSED(work);

	humidity_value = humidity_sensor_generate();
	(void)lwm2m_set_f64(&LWM2M_OBJ(HUMIDITY_OBJECT_ID, HUMIDITY_INSTANCE_ID,
				       HUMIDITY_RES_VALUE),
			    humidity_value);

	k_work_schedule(&humidity_work, HUMIDITY_PERIOD);
}

int humidity_sensor_init(void)
{
	int ret;
	static char units[] = "%";

	ret = lwm2m_create_object_inst(&LWM2M_OBJ(HUMIDITY_OBJECT_ID,
						  HUMIDITY_INSTANCE_ID));
	if (ret < 0 && ret != -EEXIST) {
		LOG_ERR("Failed to create humidity object instance (%d)", ret);
		return ret;
	}

	(void)lwm2m_set_string(&LWM2M_OBJ(HUMIDITY_OBJECT_ID, HUMIDITY_INSTANCE_ID,
					  HUMIDITY_RES_UNITS),
			       units);

	ret = lwm2m_enable_cache(&humidity_path, humidity_cache,
				 ARRAY_SIZE(humidity_cache));
	if (ret < 0 && ret != -ENODATA) {
		LOG_WRN("Failed to enable humidity cache (%d)", ret);
	}

	ret = lwm2m_set_cache_filter(&humidity_path, lwm2m_send_sched_cache_filter);
	if (ret < 0) {
		LOG_WRN("Failed to register humidity cache filter (%d)", ret);
	}

	k_work_init_delayable(&humidity_work, humidity_work_handler);
	humidity_value = humidity_sensor_generate();
	(void)lwm2m_set_f64(&LWM2M_OBJ(HUMIDITY_OBJECT_ID, HUMIDITY_INSTANCE_ID,
				       HUMIDITY_RES_VALUE),
			    humidity_value);
	k_work_schedule(&humidity_work, HUMIDITY_PERIOD);

	return 0;
}
```

## src/humidity_sensor.h
```c
#ifndef HUMIDITY_SENSOR_H_
#define HUMIDITY_SENSOR_H_

int humidity_sensor_init(void);

#endif /* HUMIDITY_SENSOR_H_ */
```

## src/send_scheduler.h
```c
#ifndef SEND_SCHEDULER_H_
#define SEND_SCHEDULER_H_

#include <stdbool.h>
#include <zephyr/net/lwm2m.h>

int send_scheduler_init(void);
bool send_scheduler_cache_filter(const struct lwm2m_obj_path *path,
				 const struct lwm2m_time_series_elem *element);
void send_sched_handle_registration_event(void);

#endif /* SEND_SCHEDULER_H_ */
```

## src/send_scheduler_core.c
```c
#define LOG_MODULE_NAME send_scheduler
#include <zephyr/logging/log.h>
LOG_MODULE_REGISTER(LOG_MODULE_NAME, CONFIG_SEND_SCHED_LOG_LEVEL);

#include <errno.h>
#include <math.h>
#include <stdbool.h>
#include <stdint.h>
#include <stdlib.h>
#include <string.h>
#include <time.h>
#include <zephyr/kernel.h>
#include <zephyr/net/lwm2m.h>
#include <zephyr/sys/printk.h>
#include <zephyr/sys/util.h>

#include "lwm2m_engine.h"
#include "lwm2m_object.h"
#include "lwm2m_registry.h"

#include "send_scheduler.h"
#include "send_scheduler_internal.h"

bool scheduler_paused;
int32_t scheduler_max_samples;
int32_t scheduler_max_age;
bool send_sched_flush_on_update = true;

static struct k_work_delayable scheduler_age_work;
static bool scheduler_age_work_initialized;
static int32_t scheduler_accumulated_samples;

struct send_sched_rule_entry rule_entries[SEND_SCHED_RULES_MAX_INSTANCES];

static int send_sched_collect_paths(struct lwm2m_obj_path *paths,
				    size_t max_paths);
static const struct lwm2m_obj_path *
send_sched_get_configured_path(struct send_sched_rule_entry *entry);
static int send_sched_find_rule_entry(const struct lwm2m_obj_path *path,
				      struct lwm2m_obj_path *parsed_path);
void send_sched_pmax_work_handler(struct k_work *work);
static void send_sched_record_cached_sample(void);
static void send_sched_maybe_flush_on_full(struct send_sched_rule_entry *entry);
static void send_sched_ensure_age_work_initialized(void);
static bool send_sched_find_oldest_timestamp(time_t *out_ts);
static void send_sched_age_work_handler(struct k_work *work);
static void send_sched_clear_cached_rules(struct send_sched_rule_entry *entry);
static void send_sched_refresh_cached_rules(
	struct send_sched_rule_entry *entry);

#define send_sched_log_decision(verb, path_str, sample, reason) \
	LOG_DBG("%s %s sample %.3f: %s", verb, path_str, sample, reason)

/* Compare two LwM2M paths for equality */
static bool send_sched_paths_equal(const struct lwm2m_obj_path *lhs,
				   const struct lwm2m_obj_path *rhs)
{
	return lhs->obj_id == rhs->obj_id &&
	       lhs->obj_inst_id == rhs->obj_inst_id &&
	       lhs->res_id == rhs->res_id &&
	       lhs->res_inst_id == rhs->res_inst_id &&
	       lhs->level == rhs->level;
}

/* Parse a textual object path into a LwM2M obj path structure */
int send_sched_parse_path(const char *path, struct lwm2m_obj_path *out)
{
	const char *cursor = path;
	unsigned long segments[3];
	char *end = NULL;

	if (!path || path[0] != '/') {
		return -EINVAL;
	}

	cursor++;

	for (int idx = 0; idx < ARRAY_SIZE(segments); idx++) {
		unsigned long value;

		if (*cursor == '\0') {
			return -EINVAL;
		}

		errno = 0;
		value = strtoul(cursor, &end, 10);
		if (errno == ERANGE || value > UINT16_MAX) {
			return -ERANGE;
		}

		if (end == cursor) {
			return -EINVAL;
		}

		segments[idx] = value;

		if (idx < (ARRAY_SIZE(segments) - 1)) {
			if (*end != '/') {
				return -EINVAL;
			}

			cursor = end + 1;
		} else if (*end != '\0') {
			return -EINVAL;
		}
	}

	*out = LWM2M_OBJ((uint16_t)segments[0], (uint16_t)segments[1],
			 (uint16_t)segments[2]);

	return 0;
}

/* Gather unique rule paths into the provided array */
static int send_sched_collect_paths(struct lwm2m_obj_path *paths,
				    size_t max_paths)
{
	int count = 0;

	if (!paths || max_paths == 0U) {
		return 0;
	}

	for (int idx = 0; idx < SEND_SCHED_RULES_MAX_INSTANCES; idx++) {
		const struct lwm2m_obj_path *candidate;
		bool duplicate = false;

		if (count >= (int)max_paths) {
			LOG_WRN("Flush path list full (%zu entries)", max_paths);
			break;
		}

		if (rule_entries[idx].path[0] == '\0') {
			continue;
		}

		candidate = send_sched_get_configured_path(&rule_entries[idx]);
		if (!candidate) {
			LOG_WRN("Skipping invalid rule path '%s'",
				rule_entries[idx].path);
			continue;
		}

		for (int j = 0; j < count; j++) {
			if (send_sched_paths_equal(&paths[j], candidate)) {
				duplicate = true;
				break;
			}
		}

		if (duplicate) {
			continue;
		}

		paths[count++] = *candidate;
	}

	return count;
}

/* Locate the configured path for a rule entry (parsing on demand) */
static const struct lwm2m_obj_path *
send_sched_get_configured_path(struct send_sched_rule_entry *entry)
{
	struct lwm2m_obj_path parsed;

	if (!entry || entry->path[0] == '\0') {
		return NULL;
	}

	if (entry->has_configured_path) {
		return &entry->configured_path;
	}

	if (send_sched_parse_path(entry->path, &parsed) < 0) {
		return NULL;
	}

	entry->configured_path = parsed;
	entry->has_configured_path = true;

	return &entry->configured_path;
}

/* Locate the rule entry matching the given path */
static int send_sched_find_rule_entry(const struct lwm2m_obj_path *path,
				      struct lwm2m_obj_path *parsed_path)
{
	for (int idx = 0; idx < SEND_SCHED_RULES_MAX_INSTANCES; idx++) {
		struct send_sched_rule_entry *entry = &rule_entries[idx];
		const struct lwm2m_obj_path *candidate;

		if (entry->path[0] == '\0') {
			continue;
		}

		candidate = send_sched_get_configured_path(entry);
		if (!candidate) {
			continue;
		}

		if (send_sched_paths_equal(path, candidate)) {
			if (parsed_path) {
				*parsed_path = *candidate;
			}
			return idx;
		}
	}

	return -ENOENT;
}

/* Extract a floating-point value from a rule string */
static bool send_sched_rule_parse_double(const char *rule, const char *attr,
					 double *out_value)
{
	size_t attr_len;
	char *end = NULL;
	double value;

	if (!rule || !attr || !out_value) {
		return false;
	}

	attr_len = strlen(attr);
	if (strncmp(rule, attr, attr_len) != 0) {
		return false;
	}

	if (rule[attr_len] != '=') {
		return false;
	}

	errno = 0;
	value = strtod(&rule[attr_len + 1], &end);
	if (errno == ERANGE) {
		return false;
	}

	if (end == &rule[attr_len + 1] || (end && *end != '\0')) {
		return false;
	}

	*out_value = value;

	return true;
}

/* Extract an integer value from a rule string */
bool send_sched_rule_parse_int(const char *rule, const char *attr,
			       int32_t *out_value)
{
	size_t attr_len;
	char *end = NULL;
	long value;

	if (!rule || !attr || !out_value) {
		return false;
	}

	attr_len = strlen(attr);
	if (strncmp(rule, attr, attr_len) != 0) {
		return false;
	}

	if (rule[attr_len] != '=') {
		return false;
	}

	errno = 0;
	value = strtol(&rule[attr_len + 1], &end, 10);
	if (errno == ERANGE || value < INT32_MIN || value > INT32_MAX) {
		return false;
	}

	if (end == &rule[attr_len + 1] || (end && *end != '\0')) {
		return false;
	}

	*out_value = (int32_t)value;

	return true;
}

/* Cancel any pending pmax timer */
void send_sched_cancel_pmax_timer(struct send_sched_rule_entry *entry)
{
	if (!entry) {
		return;
	}

	if (entry->pmax_timer_active) {
		(void)k_work_cancel_delayable(&entry->pmax_work);
		entry->pmax_timer_active = false;
	}
}

/* Arm (or re-arm) the pmax timer if configured */
static void send_sched_arm_pmax_timer(struct send_sched_rule_entry *entry)
{
	if (!entry) {
		return;
	}

	if (entry->pmax_seconds <= 0) {
		send_sched_cancel_pmax_timer(entry);
		return;
	}

	send_sched_cancel_pmax_timer(entry);

	int64_t now_ms = k_uptime_get();
	int64_t deadline_ms = entry->pmax_deadline_ms;
	int64_t required_ms = (int64_t)entry->pmax_seconds * 1000LL;

	if (deadline_ms <= 0) {
		deadline_ms = now_ms + required_ms;
		entry->pmax_deadline_ms = deadline_ms;
	}

	int64_t delay_ms = deadline_ms - now_ms;
	if (delay_ms < 0) {
		delay_ms = 0;
	}

	k_timeout_t timeout = K_MSEC((uint32_t)MIN(delay_ms, INT32_MAX));

	if (k_work_schedule(&entry->pmax_work, timeout) < 0) {
		LOG_WRN("Failed to schedule pmax timer for %s", entry->path);
		entry->pmax_timer_active = false;
		return;
	}

	entry->pmax_timer_active = true;
}

/* Work handler that forces a SEND when pmax expires */
void send_sched_pmax_work_handler(struct k_work *work)
{
	struct k_work_delayable *dwork =
		CONTAINER_OF(work, struct k_work_delayable, work);
	struct send_sched_rule_entry *entry =
		CONTAINER_OF(dwork, struct send_sched_rule_entry, pmax_work);
	struct lwm2m_obj_path path;
	struct lwm2m_time_series_resource *cache_entry;
	int ret;
	int64_t now_ms;
	char path_buf[LWM2M_MAX_PATH_STR_SIZE];

	entry->pmax_timer_active = false;

	if (entry->path[0] == '\0') {
		return;
	}

	ret = send_sched_parse_path(entry->path, &path);
	if (ret < 0) {
		LOG_WRN("Skipping pmax cache refresh for invalid path '%s' (%d)",
			entry->path, ret);
		return;
	}

	cache_entry = lwm2m_cache_entry_get_by_object(&path);
	if (!cache_entry) {
		LOG_WRN("No cache entry available for %s when pmax expired", entry->path);
		return;
	}

	now_ms = k_uptime_get();

	if (entry->has_last_reported) {
		struct lwm2m_time_series_elem elem = entry->last_reported;
		const char *path_str = lwm2m_path_log_buf(path_buf, &path);
		char reason[64];
		time_t ts = time(NULL);

		if (ts <= 0) {
			LOG_WRN("time() unavailable for pmax cache refresh on %s", entry->path);
		} else {
			elem.t = ts;
		}

		if (!lwm2m_cache_write(cache_entry, &elem)) {
			LOG_WRN("Failed to append cached sample for %s on pmax expiry",
				entry->path);
		} else {
			entry->last_reported = elem;
			entry->has_last_reported = true;
			snprintk(reason, sizeof(reason), "pmax %d expired (cached)",
				 entry->pmax_seconds);
			send_sched_log_decision("Cache", path_str, elem.f, reason);
			send_sched_schedule_age_check();
		}
	} else {
		LOG_DBG("pmax timer fired for %s before any sample cached", entry->path);
	}

	entry->last_accept_ms = now_ms;
	entry->has_last_accept_ms = true;

	if (entry->has_pmin && entry->pmin_seconds > 0) {
		entry->pmin_deadline_ms = now_ms +
			((int64_t)entry->pmin_seconds * 1000LL);
		entry->pmin_waiting = false;
	} else {
		entry->pmin_waiting = false;
		entry->pmin_deadline_ms = 0;
	}

	if (entry->pmax_seconds > 0) {
		entry->pmax_deadline_ms = now_ms +
			((int64_t)entry->pmax_seconds * 1000LL);
		send_sched_arm_pmax_timer(entry);
	} else {
		entry->pmax_deadline_ms = 0;
	}
}

/* Trigger a composite SEND for cached resources */
int send_sched_flush_all(void)
{
	struct lwm2m_ctx *ctx;
	struct lwm2m_obj_path path_list[SEND_SCHED_RULES_MAX_INSTANCES];
	int path_count;
	int ret;

	ctx = lwm2m_rd_client_ctx();
	if (!ctx) {
		LOG_WRN("Cannot flush caches: LwM2M context unavailable");
		return -ENODEV;
	}

	path_count = send_sched_collect_paths(path_list, ARRAY_SIZE(path_list));
	if (path_count <= 0) {
		LOG_WRN("No cached resources registered for flush");
		return -ENOENT;
	}

	if (path_count > CONFIG_LWM2M_COMPOSITE_PATH_LIST_SIZE) {
		LOG_WRN("Limiting flush to %d path(s)",
			CONFIG_LWM2M_COMPOSITE_PATH_LIST_SIZE);
		path_count = CONFIG_LWM2M_COMPOSITE_PATH_LIST_SIZE;
	}

	ret = lwm2m_send_cb(ctx, path_list, (uint8_t)path_count, NULL);
	if (ret < 0) {
		LOG_ERR("Failed to flush cached data (%d)", ret);
	} else {
		LOG_INF("Triggered LwM2M send for %d cached path(s)", path_count);
	}

	send_sched_reset_accumulated_samples();
	send_sched_schedule_age_check();

	return ret;
}

void send_sched_reset_accumulated_samples(void)
{
	scheduler_accumulated_samples = 0;
}

void send_sched_enforce_max_sample_limit(void)
{
	if (scheduler_max_samples <= 0) {
		return;
	}

	if (scheduler_accumulated_samples >= scheduler_max_samples) {
		LOG_INF("Accumulated %d samples (limit %d), forcing SEND",
			scheduler_accumulated_samples, scheduler_max_samples);
		scheduler_accumulated_samples = 0;
		(void)send_sched_flush_all();
	}
}

static void send_sched_record_cached_sample(void)
{
	if (scheduler_accumulated_samples < INT32_MAX) {
		scheduler_accumulated_samples++;
	}

	send_sched_enforce_max_sample_limit();
}

static void send_sched_maybe_flush_on_full(struct send_sched_rule_entry *entry)
{
	int slots;

	if (!entry || !entry->has_cached_path) {
		return;
	}

	slots = lwm2m_cache_free_slots_get(&entry->cached_path);
	if (slots < 0) {
		/* No cache entry or API failure, nothing to do */
		return;
	}

	if (slots == 0) {
		LOG_DBG("Cache full for %s, triggering global SEND", entry->path);
		(void)send_sched_flush_all();
	}
}

static void send_sched_ensure_age_work_initialized(void)
{
	if (!scheduler_age_work_initialized) {
		k_work_init_delayable(&scheduler_age_work, send_sched_age_work_handler);
		scheduler_age_work_initialized = true;
	}
}

static bool send_sched_find_oldest_timestamp(time_t *out_ts)
{
	bool found = false;
	time_t oldest = 0;

	for (int idx = 0; idx < SEND_SCHED_RULES_MAX_INSTANCES; idx++) {
		struct send_sched_rule_entry *entry = &rule_entries[idx];
		struct lwm2m_obj_path path;
		struct lwm2m_time_series_resource *cache_entry;
		struct lwm2m_time_series_elem elem;

		if (entry->path[0] == '\0') {
			continue;
		}

		if (entry->has_cached_path) {
			path = entry->cached_path;
		} else if (send_sched_parse_path(entry->path, &path) < 0) {
			continue;
		}

		cache_entry = lwm2m_cache_entry_get_by_object(&path);
		if (!cache_entry || ring_buf_is_empty(&cache_entry->rb)) {
			continue;
		}

		if (ring_buf_peek(&cache_entry->rb, (uint8_t *)&elem,
				  sizeof(elem)) != sizeof(elem)) {
			continue;
		}

		if (!found || elem.t < oldest) {
			oldest = elem.t;
			found = true;
		}
	}

	if (found && out_ts) {
		*out_ts = oldest;
	}

	return found;
}

void send_sched_process_max_age(bool allow_flush)
{
	if (scheduler_max_age <= 0) {
		if (scheduler_age_work_initialized) {
			k_work_cancel_delayable(&scheduler_age_work);
		}
		return;
	}

	send_sched_ensure_age_work_initialized();

	time_t now = time(NULL);
	time_t oldest_ts;

	if (now <= 0 || !send_sched_find_oldest_timestamp(&oldest_ts)) {
		if (scheduler_age_work_initialized) {
			k_work_cancel_delayable(&scheduler_age_work);
		}
		return;
	}

	int64_t age = (int64_t)now - (int64_t)oldest_ts;
	if (age < 0) {
		age = 0;
	}

	if (allow_flush && age >= scheduler_max_age) {
		LOG_INF("Oldest cached sample age %llds exceeds max %ds, forcing SEND",
			(long long)age, scheduler_max_age);
		(void)send_sched_flush_all();
		send_sched_schedule_age_check();
		return;
	}

	int64_t remaining = (int64_t)scheduler_max_age - age;
	if (remaining < 1) {
		remaining = 1;
	}

	int64_t delay_ms = remaining * 1000LL;
	if (delay_ms > INT32_MAX) {
		delay_ms = INT32_MAX;
	}

	k_work_reschedule(&scheduler_age_work, K_MSEC((uint32_t)delay_ms));
}

void send_sched_schedule_age_check(void)
{
	if (scheduler_max_age <= 0) {
		if (scheduler_age_work_initialized) {
			k_work_cancel_delayable(&scheduler_age_work);
		}
		return;
	}

	send_sched_process_max_age(false);
}

static void send_sched_age_work_handler(struct k_work *work)
{
	ARG_UNUSED(work);

	send_sched_process_max_age(true);
}

static void send_sched_clear_cached_rules(struct send_sched_rule_entry *entry)
{
	entry->has_rule_gt = false;
	entry->has_rule_lt = false;
	entry->has_rule_st = false;
	entry->has_rule_pmin = false;
	entry->has_rule_pmax = false;
	entry->rule_gt_value = 0.0;
	entry->rule_lt_value = 0.0;
	entry->rule_st_value = 0.0;
	entry->rule_pmin_seconds = 0;
	entry->rule_pmax_seconds = 0;
	entry->rules_dirty = false;
}

static void send_sched_refresh_cached_rules(struct send_sched_rule_entry *entry)
{
	send_sched_clear_cached_rules(entry);

	for (int idx = 0; idx < SEND_SCHED_MAX_RULE_STRINGS; idx++) {
		const char *rule = entry->rules[idx];

		if (rule[0] == '\0') {
			continue;
		}

		if (!entry->has_rule_gt &&
		    send_sched_rule_parse_double(rule, "gt",
						 &entry->rule_gt_value)) {
			entry->has_rule_gt = true;
			continue;
		}

		if (!entry->has_rule_lt &&
		    send_sched_rule_parse_double(rule, "lt",
						 &entry->rule_lt_value)) {
			entry->has_rule_lt = true;
			continue;
		}

		if (!entry->has_rule_st &&
		    send_sched_rule_parse_double(rule, "st",
						 &entry->rule_st_value)) {
			entry->has_rule_st = true;
			continue;
		}

		if (!entry->has_rule_pmin &&
		    send_sched_rule_parse_int(rule, "pmin",
					      &entry->rule_pmin_seconds)) {
			if (entry->rule_pmin_seconds < 0) {
				entry->rule_pmin_seconds = 0;
			}
			entry->has_rule_pmin = true;
			continue;
		}

		if (!entry->has_rule_pmax &&
		    send_sched_rule_parse_int(rule, "pmax",
					      &entry->rule_pmax_seconds)) {
			if (entry->rule_pmax_seconds < 0) {
				entry->rule_pmax_seconds = 0;
			}
			entry->has_rule_pmax = true;
			continue;
		}
	}

	entry->rules_dirty = false;
}

void send_sched_handle_registration_event(void)
{
	if (!send_sched_flush_on_update) {
		return;
	}

	(void)send_sched_flush_all();
}

/* Decide whether a sample should be cached for the configured path */
bool send_scheduler_cache_filter(const struct lwm2m_obj_path *path,
				 const struct lwm2m_time_series_elem *element)
{
	int entry_idx;
	struct lwm2m_obj_path entry_path;
	struct send_sched_rule_entry *entry;
	double sample_value;
	bool trigger = false;
	bool trigger_due_to_pmin_expiry = false;
	char path_buf[LWM2M_MAX_PATH_STR_SIZE];
	struct lwm2m_obj_path path_copy;
	const char *path_str = "unknown";
	char keep_reason[96] = {0};
	char drop_reason[96] = {0};
	bool drop_reason_set = false;
	int64_t now_ms;

	if (!path || !element) {
		return true;
	}

	path_copy = *path;
	path_str = lwm2m_path_log_buf(path_buf, &path_copy);
	sample_value = element->f;
	now_ms = k_uptime_get();

	if (scheduler_paused) {
		send_sched_log_decision("Drop", path_str, sample_value,
					"scheduler paused");
		return false;
	}

	entry_idx = send_sched_find_rule_entry(path, &entry_path);
	if (entry_idx < 0) {
		send_sched_log_decision("Drop", path_str, sample_value,
					"no rule entry");
		return false;
	}

	entry = &rule_entries[entry_idx];

	if (!entry->has_cached_path ||
	    !send_sched_paths_equal(&entry->cached_path, &entry_path)) {
		entry->cached_path = entry_path;
		entry->has_cached_path = true;
		entry->has_last_reported = false;
		entry->has_last_observed = false;
	}

	if (entry->rules_dirty) {
		send_sched_refresh_cached_rules(entry);
	}

	bool has_gt = entry->has_rule_gt;
	bool has_lt = entry->has_rule_lt;
	bool has_st = entry->has_rule_st;
	bool has_pmin_rule = entry->has_rule_pmin;
	bool has_pmax_rule = entry->has_rule_pmax;
	double gt_value = entry->rule_gt_value;
	double lt_value = entry->rule_lt_value;
	double st_value = entry->rule_st_value;
	int32_t pmin_seconds = entry->rule_pmin_seconds;
	int32_t pmax_seconds = entry->rule_pmax_seconds;

	bool effective_has_pmin = (has_pmin_rule && pmin_seconds > 0);
	bool effective_has_pmax = (has_pmax_rule && pmax_seconds > 0);
	int64_t pmin_required_ms = 0;
	int64_t pmax_required_ms = 0;

	if (effective_has_pmin) {
		pmin_required_ms = (int64_t)pmin_seconds * 1000LL;
	}

	if (effective_has_pmax && effective_has_pmin && pmax_seconds <= pmin_seconds) {
		LOG_WRN("Ignoring pmax <= pmin for path %s", entry->path);
		effective_has_pmax = false;
	}

	entry->has_pmin = effective_has_pmin;
	entry->pmin_seconds = effective_has_pmin ? pmin_seconds : 0;
	if (!effective_has_pmin) {
		entry->pmin_waiting = false;
		entry->pmin_deadline_ms = 0;
	}

	entry->pmax_seconds = effective_has_pmax ? pmax_seconds : 0;
	if (effective_has_pmax) {
		pmax_required_ms = (int64_t)pmax_seconds * 1000LL;
		if (entry->has_last_accept_ms) {
			entry->pmax_deadline_ms = entry->last_accept_ms + pmax_required_ms;
		} else if (entry->pmax_deadline_ms == 0) {
			entry->pmax_deadline_ms = now_ms + pmax_required_ms;
		}
		send_sched_arm_pmax_timer(entry);
	} else {
		send_sched_cancel_pmax_timer(entry);
		entry->pmax_deadline_ms = 0;
	}

	if (effective_has_pmin && entry->pmin_waiting &&
	    now_ms >= entry->pmin_deadline_ms) {
		trigger = true;
		trigger_due_to_pmin_expiry = true;
		entry->pmin_waiting = false;
		snprintk(keep_reason, sizeof(keep_reason),
			 "pmin %d expired", pmin_seconds);
	}

	if (effective_has_pmax && entry->pmax_deadline_ms > 0 &&
	    now_ms >= entry->pmax_deadline_ms) {
		trigger = true;
		if (keep_reason[0] == '\0') {
			snprintk(keep_reason, sizeof(keep_reason),
				 "pmax %d expired", pmax_seconds);
		}
	}

	if (!has_gt && !has_lt && !has_st) {
		trigger = true;
		snprintk(keep_reason, sizeof(keep_reason),
			 "no threshold rules configured");
	}

	if (has_gt) {
		double prev = entry->has_last_observed ? entry->last_observed : sample_value;

		if (sample_value > gt_value) {
			if (!entry->has_last_observed || entry->last_observed <= gt_value) {
				trigger = true;
				snprintk(keep_reason, sizeof(keep_reason),
					 "crossed gt %.3f (prev %.3f)", gt_value, prev);
			} else {
				snprintk(drop_reason, sizeof(drop_reason),
					 "above gt %.3f but prev %.3f also above",
					 gt_value, prev);
				drop_reason_set = true;
			}
		}
	}

	if (!trigger && has_lt) {
		double prev = entry->has_last_observed ? entry->last_observed : sample_value;

		if (sample_value < lt_value) {
			if (!entry->has_last_observed || entry->last_observed >= lt_value) {
				trigger = true;
				snprintk(keep_reason, sizeof(keep_reason),
					 "crossed lt %.3f (prev %.3f)", lt_value, prev);
			} else if (!drop_reason_set) {
				snprintk(drop_reason, sizeof(drop_reason),
					 "below lt %.3f but prev %.3f also below",
					 lt_value, prev);
				drop_reason_set = true;
			}
		}
	}

	if (!trigger && has_st) {
		if (!entry->has_last_reported) {
			trigger = true;
			snprintk(keep_reason, sizeof(keep_reason),
				 "no prior sample, st %.3f", st_value);
		} else {
			double delta = sample_value - entry->last_reported.f;

			if (delta < 0.0) {
				delta = -delta;
			}

			if (delta >= st_value) {
				trigger = true;
				snprintk(keep_reason, sizeof(keep_reason),
					 "delta %.3f >= st %.3f", delta, st_value);
			} else if (!drop_reason_set) {
				snprintk(drop_reason, sizeof(drop_reason),
					 "delta %.3f < st %.3f", delta, st_value);
				drop_reason_set = true;
			}
		}
	}

	entry->last_observed = sample_value;
	entry->has_last_observed = true;

	if (!trigger) {
		if (!drop_reason_set) {
			snprintk(drop_reason, sizeof(drop_reason), "no rule triggered");
		}
		send_sched_log_decision("Drop", path_str, sample_value, drop_reason);
		return false;
	}

	if (effective_has_pmin && entry->has_last_accept_ms &&
	    !trigger_due_to_pmin_expiry) {
		int64_t elapsed_ms = now_ms - entry->last_accept_ms;

		if (elapsed_ms < pmin_required_ms) {
			int64_t remaining_ms = pmin_required_ms - elapsed_ms;

			entry->pmin_waiting = true;
			entry->pmin_deadline_ms = entry->last_accept_ms + pmin_required_ms;

			snprintk(drop_reason, sizeof(drop_reason),
				 "pmin %d active (%lld ms remaining)",
				 pmin_seconds, (long long)remaining_ms);
			send_sched_log_decision("Defer", path_str, sample_value, drop_reason);
			return false;
		}
	}

	entry->last_reported = *element;
	entry->has_last_reported = true;
	entry->last_accept_ms = now_ms;
	entry->has_last_accept_ms = true;

	if (effective_has_pmin) {
		entry->pmin_deadline_ms = entry->last_accept_ms + pmin_required_ms;
		entry->pmin_waiting = false;
	} else {
		entry->pmin_waiting = false;
		entry->pmin_deadline_ms = 0;
	}

	if (entry->pmax_seconds > 0) {
		entry->pmax_deadline_ms = entry->last_accept_ms +
			((int64_t)entry->pmax_seconds * 1000LL);
		send_sched_arm_pmax_timer(entry);
	} else {
		send_sched_cancel_pmax_timer(entry);
		entry->pmax_deadline_ms = 0;
	}

	if (keep_reason[0] == '\0') {
		snprintk(keep_reason, sizeof(keep_reason), "rule triggered");
	}

	send_sched_log_decision("Keep", path_str, sample_value, keep_reason);
	send_sched_record_cached_sample();
	send_sched_maybe_flush_on_full(entry);
	send_sched_schedule_age_check();

	return true;
}
```

## src/send_scheduler_internal.h
```c
#ifndef SEND_SCHEDULER_INTERNAL_H_
#define SEND_SCHEDULER_INTERNAL_H_

#include <stdbool.h>
#include <stdint.h>
#include <zephyr/kernel.h>
#include <zephyr/net/lwm2m.h>

/* Provide a small buffer for rule definitions that the engine can mutate */
#define SEND_SCHED_MAX_RULE_STRINGS 4
#define SEND_SCHED_RULE_STRING_SIZE 64
#define SEND_SCHED_RULES_MAX_INSTANCES 4

/* Aggregated bookkeeping for one scheduler rule instance */
struct send_sched_rule_entry {
	char path[SEND_SCHED_RULE_STRING_SIZE]; /* LwM2M path string (/obj/inst/res) */
	struct lwm2m_obj_path cached_path; /* Parsed path for cache lookups */
	bool has_cached_path; /* Guard for cached_path validity */
	struct lwm2m_obj_path configured_path; /* Parsed resource path from */
					       /* /20001/X/0 */
	bool has_configured_path; /* Guard for configured_path validity */
	char rules[SEND_SCHED_MAX_RULE_STRINGS][SEND_SCHED_RULE_STRING_SIZE];
				 /* Raw rule strings (gt/lt/st/pmin/pmax) */
	double last_observed; /* Most recent sample seen, even if dropped */
	bool has_last_observed; /* Guard for last_observed validity */
	struct lwm2m_time_series_elem last_reported; /* Last sample committed */
	bool has_last_reported; /* Guard for last_reported validity */
	int64_t last_accept_ms; /* Monotonic timestamp (ms) of last accepted sample */
	bool has_last_accept_ms; /* Guard for last_accept_ms */
	int64_t pmin_deadline_ms; /* Next time pmin allows a sample */
	bool pmin_waiting; /* True when we are deferring because of pmin */
	bool has_pmin; /* pmin is configured (>0) */
	int32_t pmin_seconds; /* Cached pmin seconds value */
	int64_t pmax_deadline_ms; /* Next time pmax requires a cached refresh */
	int32_t pmax_seconds; /* Cached pmax seconds value */
	struct k_work_delayable pmax_work; /* Work item used to enforce pmax */
	bool pmax_timer_active; /* True if the pmax timer is scheduled */
	bool rules_dirty; /* True when parsed rule cache needs refresh */
	bool has_rule_gt;
	bool has_rule_lt;
	bool has_rule_st;
	bool has_rule_pmin;
	bool has_rule_pmax;
	double rule_gt_value;
	double rule_lt_value;
	double rule_st_value;
	int32_t rule_pmin_seconds;
	int32_t rule_pmax_seconds;
};

extern bool scheduler_paused;
extern int32_t scheduler_max_samples;
extern int32_t scheduler_max_age;
extern bool send_sched_flush_on_update;
extern struct send_sched_rule_entry
	rule_entries[SEND_SCHED_RULES_MAX_INSTANCES];

int send_sched_parse_path(const char *path, struct lwm2m_obj_path *out);
bool send_sched_rule_parse_int(const char *rule, const char *attr,
			       int32_t *out_value);
void send_sched_cancel_pmax_timer(struct send_sched_rule_entry *entry);
void send_sched_pmax_work_handler(struct k_work *work);
int send_sched_flush_all(void);
void send_sched_schedule_age_check(void);
void send_sched_process_max_age(bool allow_flush);
void send_sched_enforce_max_sample_limit(void);
void send_sched_reset_accumulated_samples(void);
void send_sched_handle_registration_event(void);

#endif /* SEND_SCHEDULER_INTERNAL_H_ */
```

## src/temperature_sensor.c
```c
#define LOG_MODULE_NAME temperature_sensor
#include <zephyr/logging/log.h>
LOG_MODULE_REGISTER(LOG_MODULE_NAME, LOG_LEVEL_INF);

#include <errno.h>
#include <stdint.h>
#include <zephyr/kernel.h>
#include <zephyr/net/lwm2m.h>
#include <zephyr/net/lwm2m_send_scheduler.h>
#include <zephyr/random/random.h>
#include <zephyr/sys/util.h>

#include "temperature_sensor.h"

#define TEMPERATURE_OBJECT_ID 3303
#define TEMPERATURE_INSTANCE_ID 0
#define TEMPERATURE_RES_VALUE 5700
#define TEMPERATURE_RES_UNITS 5701

#define TEMPERATURE_PERIOD K_SECONDS(2)
#define TEMPERATURE_BASE 20.0
#define TEMPERATURE_VARIATION 5.0

static struct k_work_delayable temperature_work;
static double temperature_value;
static struct lwm2m_time_series_elem temperature_cache[10];
static const struct lwm2m_obj_path temperature_path =
	LWM2M_OBJ(TEMPERATURE_OBJECT_ID, TEMPERATURE_INSTANCE_ID,
		  TEMPERATURE_RES_VALUE);

static double temperature_sensor_generate(void)
{
	uint32_t rand = sys_rand32_get();
	double scale = (double)rand / (double)UINT32_MAX;

	return TEMPERATURE_BASE + (scale * TEMPERATURE_VARIATION);
}

static void temperature_work_handler(struct k_work *work)
{
	ARG_UNUSED(work);

	temperature_value = temperature_sensor_generate();
	(void)lwm2m_set_f64(&LWM2M_OBJ(TEMPERATURE_OBJECT_ID, TEMPERATURE_INSTANCE_ID,
				       TEMPERATURE_RES_VALUE),
			    temperature_value);

	k_work_schedule(&temperature_work, TEMPERATURE_PERIOD);
}

int temperature_sensor_init(void)
{
	int ret;
	static char units[] = "C";

	ret = lwm2m_create_object_inst(&LWM2M_OBJ(TEMPERATURE_OBJECT_ID,
						  TEMPERATURE_INSTANCE_ID));
	if (ret < 0 && ret != -EEXIST) {
		LOG_ERR("Failed to create temperature object instance (%d)", ret);
		return ret;
	}

	(void)lwm2m_set_string(&LWM2M_OBJ(TEMPERATURE_OBJECT_ID,
					  TEMPERATURE_INSTANCE_ID,
					  TEMPERATURE_RES_UNITS),
			       units);

	ret = lwm2m_enable_cache(&temperature_path, temperature_cache,
				 ARRAY_SIZE(temperature_cache));
	if (ret < 0 && ret != -ENODATA) {
		LOG_WRN("Failed to enable temperature cache (%d)", ret);
	}

	ret = lwm2m_set_cache_filter(&temperature_path, lwm2m_send_sched_cache_filter);
	if (ret < 0) {
		LOG_WRN("Failed to register temperature cache filter (%d)", ret);
	}

	k_work_init_delayable(&temperature_work, temperature_work_handler);
	temperature_value = temperature_sensor_generate();
	(void)lwm2m_set_f64(&LWM2M_OBJ(TEMPERATURE_OBJECT_ID, TEMPERATURE_INSTANCE_ID,
				       TEMPERATURE_RES_VALUE),
			    temperature_value);
	k_work_schedule(&temperature_work, TEMPERATURE_PERIOD);

	return 0;
}
```

## src/temperature_sensor.h
```c
#ifndef TEMPERATURE_SENSOR_H_
#define TEMPERATURE_SENSOR_H_

int temperature_sensor_init(void);

#endif /* TEMPERATURE_SENSOR_H_ */
```
